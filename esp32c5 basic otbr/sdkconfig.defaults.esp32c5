## esp32c5 basic otbr/sdkconfig.defaults.esp32c5
```kconfig
CONFIG_ESP_BR_BOARD_P4=y (these default options will work well for C5 as well)
CONFIG_ESP_CONSOLE_UART_DEFAULT=y if you are using the UART USB-C port on the ESP32-C5 DevKit)
CONFIG_ESP_BR_C6_TARGET=y
CONFIG_ESPTOOLPY_FLASHSIZE_4MB=y

CONFIG_AUTO_UPDATE_RCP=n

CONFIG_ESP_WIFI_REMOTE_EAP_ENABLED=n
CONFIG_ESP_WIFI_REMOTE_LIBRARY_HOSTED=n		# geen espressif/esp_hosted: "*" in idf_component.yml
CONFIG_EXAMPLE_WIFI_SSID="HaakakkerN"
CONFIG_EXAMPLE_WIFI_PASSWORD="HaakAkker"
CONFIG_OPENTHREAD_CLI_OTA=n
CONFIG_OPENTHREAD_BR_START_WEB=y
CONFIG_OPENTHREAD_BR_AUTO_START=y

CONFIG_LWIP_LOCAL_HOSTNAME="OTBR RCP"

#
# Board Configuration
#
CONFIG_PIN_TO_RCP_RESET=7
CONFIG_PIN_TO_RCP_BOOT=8
CONFIG_PIN_TO_RCP_TX=4
CONFIG_PIN_TO_RCP_RX=5
# end of Board Configuration


#
# Thread Operational Dataset
#
CONFIG_OPENTHREAD_NETWORK_NAME="OT-Haakakker"
CONFIG_OPENTHREAD_MESH_LOCAL_PREFIX="fdcb:8049:1ec2:ae4a::/64" // "fd00:db8:a0:0::/64"
CONFIG_OPENTHREAD_NETWORK_CHANNEL=15
CONFIG_OPENTHREAD_NETWORK_PANID=0x1234
CONFIG_OPENTHREAD_NETWORK_EXTPANID="1111111122222222"
CONFIG_OPENTHREAD_NETWORK_MASTERKEY="00112233445566778899aabbccddeeff"
CONFIG_OPENTHREAD_NETWORK_PSKC="445f2b5ca6f2a93a55ce570a70efeecb"
# end of Thread Operational Dataset
```
